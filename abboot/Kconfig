## abboot/Kconfig
```kconfig
# SPDX-License-Identifier: GPL-2.0-or-later
#
# abboot: the boot layer's U-Boot part (SPEC.md), board-independent. uboot/install.sh
# copies this directory into a U-Boot tree as boot/abboot/, and uboot/patches/0001 sources this
# file from boot/Kconfig. A board selects ABBOOT and sets the options below in its defconfig.

menuconfig ABBOOT
	bool "abboot: boot the A/B slot of the boot layer's record (SPEC.md)"
	depends on ARM64
	select FS_EXT4
	select SHA1
	select CMD_BOOTI
	select SUPPORT_RAW_INITRD
	help
	  The slot to boot comes from bootloader_control at misc byte 2048. A slot not yet
	  booted successfully loses a try each boot, and one out of tries falls back to the
	  other. Each slot's kernel is /slots/<x>/boot/boot.img on the store; a slot whose kernel
	  cannot be used loses a try and the other slot boots whole; then the rescue kernel, then
	  a screen that stays. The command line gets ab.slot=<x> ab.kernel=<x|rescue>. The
	  command is "abboot". A board is configuration only: everything below.

if ABBOOT

config AB_DEV_IFACE
	string "Block device interface the partitions are on"
	default "mmc"

config AB_DEV_NUM
	int "Its device number"
	default 0

config AB_MISC_PART
	string "Name of the partition holding the A/B record (byte 2048)"
	default "misc"

config AB_STORE_PART
	string "Name of the ext4 partition holding the slots (/slots/<x>/boot/)"
	default "system"

config AB_SELF_PART
	string "Name of the partition U-Boot itself is in: never loaded as a kernel"
	default "boot"

config AB_RESCUE_PART
	string "Name of the partition holding the rescue kernel (an Android boot image)"
	default "recovery"

config AB_RESCUE_FILE
	string "Rescue kernel from this file on the store instead (test builds)"
	default ""
	help
	  Empty: the rescue kernel is the boot image in AB_RESCUE_PART. A test build that runs
	  from that partition itself takes it from a file on the store, e.g. /rescue.img.

config AB_SELF_MARKER
	string "A string every build of this U-Boot carries"
	default "abboot-uboot-image"
	help
	  abboot never boots an image whose kernel holds it (a test U-Boot in the rescue
	  partition, or a U-Boot copied into a slot by mistake). Tools that must never write
	  over U-Boot look for it too.

config AB_BOARD_INIT
	bool "abboot provides the board's start-up functions"
	select BOARD_LATE_INIT
	help
	  board_early_init_f (with BOARD_EARLY_INIT_F), board_init, board_late_init and the
	  exception and panic hooks: the crumbs, and the test-slot build's misc command. For a
	  board that is configuration only (no C file of its own).

config AB_HEADER_KEYS
	string "Kernel parameters the booted image's header command line sets for the whole line"
	default "root= rootfstype= rootflags= init= rdinit= rootwait ro|rw skip_initramfs"
	help
	  The command line is the prior stage's, with this U-Boot image's header command line
	  replaced by the booted image's. A parameter listed here (key= or a flag; a|b is one
	  group) that the booted image's header sets is dropped from the rest of the line, so
	  that the image decides it (e.g. its root). Empty: nothing dropped.

config AB_DT_MERGE
	bool "Carry what the prior stage added to its device tree into the kernel's"
	default y
	help
	  Every node and property of the prior stage's tree that the device tree packed into
	  this U-Boot image (read from the partition U-Boot was started from) does not have, or
	  has with another value, is set in the booted image's tree. No names are listed.

config AB_DT_CARRY
	string "Properties carried from the prior tree whatever the packed tree says"
	depends on AB_DT_MERGE
	default ""
	help
	  Space-separated property names: per-unit data that is also in the packed tree (e.g.
	  a calibration blob an OS put into the device's boot image), set from the prior tree into the
	  booted tree's node holding the same property with the same length.

config AB_KEY_UP_REG
	hex "Register the Up key is read from (0: no key)"
	default 0x0

config AB_KEY_UP_BIT
	int "Its bit"
	default 0

config AB_KEY_DOWN_REG
	hex "Register the Down key is read from (0: no key)"
	default 0x0

config AB_KEY_DOWN_BIT
	int "Its bit"
	default 0

config AB_KEYS_ACTIVE_LOW
	bool "A key reads 0 while it is held"
	default y

config AB_SCREEN_CLEAR
	bool "Clear the simple-framebuffer's region (its reg) before the menu draws"
	depends on AB_MENU
	default y
	help
	  Opaque black (0xff000000) over the reg of the control device tree's
	  simple-framebuffer node, only that: the page the prior stage scans out.

config AB_SCREEN_NEED_RESERVED
	bool "Draw only if the prior stage's tree reserves that framebuffer region"
	depends on AB_MENU
	default y

config AB_MENU_HIDE_IF_PRIOR_ARG
	string "No menu when the prior stage's command line has this token (empty: never)"
	default ""
	help
	  e.g. "fps=6000" on the Echo Show 5 2nd gen: on boots whose screen shows nothing, its
	  bootloader's command line carries it, so the pick boots at once.

choice
	prompt "How abboot resets the device after a failure"
	default AB_RESET_PSCI

config AB_RESET_PSCI
	bool "reset (PSCI SYSTEM_RESET), then the watchdog"

config AB_RESET_WDT
	bool "the watchdog only (PSCI 0.1 has no SYSTEM_RESET)"

endchoice

config AB_TESTSLOT
	bool "Test build (U-Boot in the recovery partition, started once through misc's boot-recovery)"
	help
	  The 32-byte misc command (boot-recovery, which sent the prior stage there) is cleared
	  as soon as the eMMC works, and AB_TEST_MARKER goes on the kernel's command line.

config AB_TEST_MARKER
	string "The test-slot build's command line marker"
	depends on AB_TESTSLOT
	default "ab.test=1"

config AB_STICKY
	bool "Sticky test slot: misc's boot-recovery set again before booti"
	depends on AB_TESTSLOT
	help
	  A kernel that panics or hangs is reset back into this U-Boot (in the recovery
	  partition), so the tries run out and the fallback happens without a run per boot.

config AB_DEBUG_BOOT
	bool "Diagnostic build: debug() output from booti, bootm, the FDT code, LMB and video"
	help
	  Builds those files with -DDEBUG (uboot/patches/0003); with CONSOLE_RECORD and AB_CRUMBS the
	  output lands in misc.

config AB_READONLY
	bool "Never write the record: show and follow it only (a first, safe test)"

config AB_MENU
	bool "The boot menu (Slot A, Slot B, a 5 s countdown) on the video console"
	depends on VIDEO
	help
	  Keys come from board_ab_keys(): Up and Down move the bar, both together start the
	  selected entry. A board's board_ab_menu_visible() can leave it out on a boot whose
	  screen shows nothing.

config AB_MENU_HINT
	string "The hint at the bottom of the menu"
	default "Volume up or down to choose, both to start"

config AB_WARN_MS
	int "A warning stays on the screen at least this long (ms)"
	default 3000

config AB_STAY_HINT
	string "The second line of the stay screen (no kernel at all)"
	default "Use the bootloader's recovery to flash a kernel"

config AB_INIT
	string "init= for the kernel, replacing any (empty: the board's line as it is)"
	default ""

config AB_SLOT_ARGS
	string "Command line tokens for a slot's boot (not the rescue system's)"
	default "panic=5"
	help
	  The boot layer's watchdog contract with the OS, e.g. "watchdog.open_timeout=120
	  mtk_wdt.nowayout=1 panic=5": a token whose key (up to '=') is already on the line is
	  left out.

config AB_IMAGE_MAX
	hex "Largest boot image read (bytes, at $loadaddr)"
	default 0x06000000

config AB_FDT_GROW
	hex "Room for the board's additions to a slot's device tree"
	default 0x40000

config AB_CRUMBS
	bool "Diagnostics: a crumb per stage and the console record in misc"
	help
	  SPEC.md, "Diagnostics". Each area is written only while it is empty or
	  already holds the boot layer's data.

config AB_CRUMBS_BLOCK
	int "misc block of the crumbs (two blocks)"
	depends on AB_CRUMBS
	default 1016

config AB_LOG_FIRST
	int "misc block where the console record starts"
	depends on AB_CRUMBS
	default 896

config AB_LOG_BLOCKS
	int "Its length in blocks"
	depends on AB_CRUMBS
	default 120

config AB_CRUMBS_RAM
	hex "RAM address of the crumbs from before relocation (0: none)"
	depends on AB_CRUMBS
	default 0x0

endif
```

## boards/amazon-echo-show-5-gen2/u-boot/configs/amazon_cronos_defconfig
```kconfig
CONFIG_ARM=y
CONFIG_ARCH_MEDIATEK=y
CONFIG_TARGET_MT8183=y
CONFIG_BOARD_AMAZON_CRONOS=y
CONFIG_COUNTER_FREQUENCY=13000000
CONFIG_POSITION_INDEPENDENT=y
CONFIG_INIT_SP_RELATIVE=y
CONFIG_SYS_INIT_SP_BSS_OFFSET=0x80000
CONFIG_TEXT_BASE=0x40200000
CONFIG_SYS_MALLOC_F_LEN=0x10000
CONFIG_SYS_MALLOC_LEN=0x2000000
CONFIG_NR_DRAM_BANKS=1
CONFIG_MTK_MEM_MAP_DDR_SIZE=0x3f000000
CONFIG_DEFAULT_DEVICE_TREE="mt8163-amazon-cronos-uboot"
CONFIG_SYS_LOAD_ADDR=0x50000000
# CONFIG_PSCI_RESET is not set
# CONFIG_EFI_LOADER is not set
# CONFIG_ANDROID_BOOT_IMAGE is not set
# CONFIG_ARCH_FIXUP_FDT_MEMORY is not set
# CONFIG_BOOTSTD_DEFAULTS is not set
CONFIG_BOOTDELAY=0
CONFIG_USE_BOOTCOMMAND=y
CONFIG_BOOTCOMMAND="abboot"
CONFIG_SYS_CBSIZE=1024
CONFIG_SYS_PBSIZE=1100
# CONFIG_DISPLAY_BOARDINFO is not set
CONFIG_HUSH_PARSER=y
CONFIG_CMD_BOOTI=y
CONFIG_SUPPORT_RAW_INITRD=y
CONFIG_CMD_MMC=y
CONFIG_CMD_PART=y
CONFIG_CMD_FDT=y
CONFIG_CMD_SLEEP=y
CONFIG_CMD_WDT=y
CONFIG_PARTITION_UUIDS=y
CONFIG_EFI_PARTITION=y
CONFIG_ENV_IS_NOWHERE=y
CONFIG_ENV_SOURCE_FILE="cronos"
CONFIG_ENV_VARS_UBOOT_RUNTIME_CONFIG=y
CONFIG_CLK=y
# CONFIG_INPUT is not set
# CONFIG_MMC_QUIRKS is not set
CONFIG_MMC_MTK=y
# CONFIG_MMC_HW_PARTITIONING is not set
# CONFIG_POWER is not set
CONFIG_BAUDRATE=921600
CONFIG_DM_SERIAL=y
CONFIG_MTK_SERIAL=y
# CONFIG_USB is not set
CONFIG_VIDEO=y
# CONFIG_VIDEO_LOGO is not set
# CONFIG_VIDEO_BPP8 is not set
# CONFIG_VIDEO_BPP16 is not set
CONFIG_VIDEO_BPP32=y
CONFIG_SYS_WHITE_ON_BLACK=y
CONFIG_CONSOLE_ROTATION=y
CONFIG_VIDEO_FONT_8X16=y
CONFIG_VIDEO_FONT_16X32=y
CONFIG_VIDEO_SIMPLE=y
CONFIG_CONSOLE_RECORD=y
CONFIG_CONSOLE_RECORD_OUT_SIZE=0x100000
CONFIG_WDT=y
CONFIG_WATCHDOG_AUTOSTART=y
CONFIG_WATCHDOG_TIMEOUT_MSECS=31000
CONFIG_WDT_MTK=y
CONFIG_WDT_MTK_LONG_LENGTH=y
# CONFIG_RANDOM_UUID is not set
# CONFIG_REGEX is not set
CONFIG_ABBOOT=y
CONFIG_AB_MENU=y
CONFIG_AB_MISC_PART="MISC"
CONFIG_AB_SELF_MARKER="abboot-echo-show-5-gen2-self"
CONFIG_AB_SLOT_ARGS="watchdog.open_timeout=120 mtk_wdt.nowayout=1 panic=5"
CONFIG_AB_STAY_HINT="Hold Volume Down and plug in USB for fastboot"
CONFIG_AB_CRUMBS=y
# Volume Up GPIO 36, Volume Down GPIO 37: GPIO_DIN3 0x10005520 (0x10005000 + 0x500 + (pin / 16) *
# 0x10), bits 4 and 5, active low. Mute (GPIO 47) never changes before Linux: not read.
CONFIG_AB_KEY_UP_REG=0x10005520
CONFIG_AB_KEY_UP_BIT=4
CONFIG_AB_KEY_DOWN_REG=0x10005520
CONFIG_AB_KEY_DOWN_BIT=5
# LK's display stalled on this boot (about 1 in 16): nothing drawn would be seen.
CONFIG_AB_MENU_HIDE_IF_PRIOR_ARG="fps=6000"
# MT8163's PSCI 0.1 has no SYSTEM_RESET.
CONFIG_AB_RESET_WDT=y
```
